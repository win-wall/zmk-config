## config/boards/shields/pinky4/Kconfig.defconfig
```kconfig
# Copyright (c) 2020 The ZMK Contributors
# SPDX-License-Identifier: MIT

if SHIELD_PINKY4

config ZMK_KEYBOARD_NAME
    default "Pinky4"
endif
if SHIELD_PINKY4
if ZMK_DISPLAY
config SSD1306
    default y
config I2C
    default y

config SSD1306
    default y
endif


if LVGL
config LV_Z_VDB_SIZE
    default 64
config LV_Z_DPI
    default 148
config LV_Z_BITS_PER_PIXEL
    default 1
choice LV_COLOR_DEPTH
    default LV_COLOR_DEPTH_1
endchoice
endif # LVGL
endif
```

## config/boards/shields/pinky4/Kconfig.shield
```kconfig
# Copyright (c) 2020 The ZMK Contributors
# SPDX-License-Identifier: MIT

config SHIELD_PINKY4
    def_bool $(shields_list_contains,pinky4_left)
```
